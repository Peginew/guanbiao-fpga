enum class Source : uint8_t { None, Usb, Web, FpgaTest, Inspection, ScanApproach };
bool inspectionNavigation=false,inspectionArrivalPending=false;
bool consoleMode=false;
uint16_t pendingInspectionTask=0,pendingInspectionPoint=0;
uint32_t inspectionArrivalMs=0;
bool inspectionArrived();
bool startInspectionGoto(float x,float y,float speed);
bool localInspectionArm(bool enabled,bool forConsole=false);
bool localInspectionCalibration(bool confirmed);
#include "Navigation.h"
NavigationState navigation;
Source navigationSource=Source::Web;
bool navigationInternal=false;
bool navigationActive();
const char *navigationStageName();
void cancelNavigation();
void finishNavigationSegment(uint32_t now);
void serviceNavigation();
bool navigationObstacleSafe(uint32_t now);
void navigationFailed(const char *reason);
bool startGoto(float x,float y,float speed);
RouteState route;
Source routeSource=Source::Web;
bool routeInternal=false;
bool routeActive();
const char *routeStageName();
void cancelRoute(const char *reason);
void finishRouteSegment(uint32_t now);
void serviceRoute();
bool startRoute(const RoutePlan &plan);
float routeRemaining();
void correctRouteStraight(float &left,float &right,float travelL,float travelR);
Source owner=Source::None,requestSource=Source::Usb;
Stage1Control control;
bool hardwareReady=false,uartReady=false,ioFault=false;
bool attached[4]={false,false,false,false};
bool statusPending=false,helpPending=false,webTaskReady=false;
uint32_t countAtStart[4]={},receivedM1=0,receivedForward=0;
uint32_t lastReportedBytes=0,lastRxReportMs=0,stoppedSinceMs=0;
uint32_t webEpoch=1;
char bootSession[17]="";
char webLeaseToken[17]="";
const char *stopSource="boot",*faultSource="none";
LineBuffer usbLine;
RxProbe fpgaRx;
QueueHandle_t webCommands=nullptr,webResults=nullptr;
portMUX_TYPE webMux=portMUX_INITIALIZER_UNLOCKED;
WebSnapshot webSnapshot;
volatile uint8_t webStopRequest=0;
volatile uint32_t webLastTouchMs=0;
constexpr uint32_t WEB_COMMAND_MAX_AGE_MS=75; // less than HTTP's 100ms ACK wait
constexpr uint32_t WEB_PAGE_LEASE_MS=2000;
bool canRequestMotion();
void setupWifi();
void webTask(void *);
void publishWebSnapshot();

